## CMakeLists.txt
```
cmake_minimum_required(VERSION 3.20.0)
find_package(Zephyr REQUIRED HINTS $ENV{ZEPHYR_BASE})
project(claude_usage_display)

# src/ on the global include path so the mbedTLS build can find
# src/mbedtls_user_config.h (CONFIG_MBEDTLS_USER_CONFIG_FILE).
zephyr_include_directories(src)

# V2/ holds pages whose CONTENT comes from the daemon rather than from C.
# Kept out of src/ deliberately: it is where new work lives while it is still
# being shaped, so it can be read, changed and abandoned in one place. See
# V2/README.md.
zephyr_include_directories(../V2/firmware)

target_sources(app PRIVATE
	../V2/firmware/ui_panel.c
	src/main.c
	src/proto.c
	src/msg_parse.c
	src/usage_view.c
	src/ui_launcher.c
	src/ui_music.c
	src/ui_pages.c
	src/ui_theme.c
	src/fmt.c
	src/cfg_store.c
	src/net_time.c
	src/ui_boot.c
	src/ui_face.c
	src/ui_qr.c
	src/bootanim_dec.c
	src/bootclip.c
	src/ui_sleep.c
	src/sleep_gate.c
	src/upd_prompt.c
	src/upd_row.c
	src/upd_tap.c
	src/whatsnew.c
	src/logo_parse.c
	src/logo.c
	src/ui_settings.c
	src/ui_anim.c
	src/ui_slide.c
	src/ui_swipe.c
	src/backlight.c
	src/ota_parse.c
	src/ota.c
	src/ui_touchfx.c
	src/usage_state.c
	src/usage_freshness.c
)

# Standalone WiFi mode only. Not stubbed and not dead-stripped -- with
# CONFIG_OVERWATCH_WIFI_MODE off these are never handed to the compiler, so the
# OAuth client id, the spoofed User-Agent and the token writer are absent from
# the image rather than merely unreachable in it. See firmware/Kconfig.
target_sources_ifdef(CONFIG_OVERWATCH_WIFI_MODE app PRIVATE
	src/net_wifi.c
	src/portal.c
	src/ui_setup.c
	src/dns_hijack.c
	src/oauth.c
	src/usage_parse.c
	src/usage_client.c
	src/tz_fetch.c
)

# Diagnostic only; CONFIG_OVERWATCH_TOUCH_TRACE is off in release builds.
target_sources_ifdef(CONFIG_OVERWATCH_TOUCH_TRACE app PRIVATE src/touch_trace.c)
```

## Kconfig
```
# Application Kconfig. Zephyr sources this in place of its own root, so the
# trailing `source "Kconfig.zephyr"` is mandatory -- without it every upstream
# symbol disappears.

menu "Overwatch"

config OVERWATCH_TOUCH_TRACE
	bool "Touch trace diagnostic"
	depends on INPUT_XPT2046
	help
	  Record every XPT2046 report into a RAM ring and dump it as CSV over
	  the console when the finger lifts. Diagnostic only -- enable via
	  trace.conf, never in a release build.


config OVERWATCH_WIFI_MODE
	bool "Standalone WiFi mode (on-device sign-in and usage fetch)"
	help
	  Build the board's own network path: the captive-portal setup flow,
	  the OAuth sign-in, the refresh-token store, and the usage fetch it
	  performs for itself.

	  Default n, and that default is the point. With it off, none of that
	  code is handed to the compiler -- no client id, no User-Agent, no
	  token writer in the shipped binary -- and the board takes its usage,
	  its clock and its updates from the daemon over USB. The source stays
	  in the tree, reviewable and buildable, rather than deleted to a
	  branch where it would stop compiling within a few refactors.

	  Turning it on needs wifi.conf too, which brings in the WiFi driver,
	  the IP stack, TLS and the HTTP client:

	    west build --sysbuild -d build-sb -b esp32_devkitc/esp32/procpu . \
	      -- -DEXTRA_CONF_FILE=wifi.conf

	  wifi.conf sets this symbol, so that one flag is the whole switch.

config OVERWATCH_PANEL_PILOT
	bool "Build for the two pilot (POC) display panels"
	help
	  The production batch and the two pilot boards carry different
	  display modules. Measured on hardware 2026-08-21, the production
	  panels differ three ways: they render mirrored, they are wired RGB
	  where the ILI9341 driver hardcodes BGR, and their backlight is far
	  brighter at the same PWM duty. The firmware compensates for all
	  three by default, because production is what ships.

	  Set this when building for one of the two pilot boards, which need
	  none of that compensation and would otherwise come out mirrored,
	  colour-swapped and dim. Enable it through pilot.conf:

	    west build -b esp32_devkitc/esp32/procpu . -- \
	      -DEXTRA_CONF_FILE=pilot.conf

	  Deliberately NOT derived from flash encryption. The pilots happen to
	  be the only fused boards today, so keying off FLASH_CRYPT_CNT would
	  work right now and then quietly break: production units get fused
	  before shipping, and the rule would build pilot firmware for them.

config OVERWATCH_BL_SCALE_PCT
	int "Backlight duty as a percent of the nominal level"
	range 10 100
	default 100 if OVERWATCH_PANEL_PILOT
	default 60
	help
	  Scales every brightness step, so that a given user-facing percent
	  means the same amount of light on either batch. Compared side by
	  side at an identical setting, the production panel had to be
	  stepped down before it matched a pilot, so it is scaled here rather
	  than by lowering the default level -- which would have shrunk the
	  usable 20..100 range instead of recentring it.

endmenu

source "Kconfig.zephyr"
```

## sysbuild.conf
```
SB_CONFIG_BOOTLOADER_MCUBOOT=y
# ECDSA P-256 (tinycrypt), NOT ed25519: the ed25519 verifier (~20 KB of fiat
# curve25519 code) overflows the ESP32's fixed 40 KB bootloader iram_seg by
# ~10 KB -- it cannot link, in either swap mode. P-256 via tinycrypt fits with
# ~3.7 KB slack (sizing runs 2026-07-18; user-approved decision).
SB_CONFIG_BOOT_SIGNATURE_TYPE_ECDSA_P256=y
# The signing-key path is supplied at build time via
# -DSB_CONFIG_BOOT_SIGNATURE_KEY_FILE=... (sysbuild does not expand ~, and no
# local path should live in the tree). tools/release.sh passes it; for a manual
# build add e.g. -DSB_CONFIG_BOOT_SIGNATURE_KEY_FILE="$HOME/.overwatch/ota_signing_key_p256.pem".
# Swap with revert (NOT upgrade-only overwrite, which cannot roll back).
#
# swap-using-move, not swap-using-scratch. Scratch moves every sector through
# the scratch partition, so each sector is written three times, and on this
# flash-encrypted part every write is a read-modify-erase-write -- the swap
# took ~4-5 MINUTES of frozen screen for a 1.28 MB image (host-clock measured
# 2026-07-25; see the warning below about the bootloader's own timestamps).
# swap-move shifts the primary image up one sector and copies in place, with
# no scratch round-trip, so it moves substantially less data.
#
# WARNING for anyone measuring this: MCUboot's own log timestamps on this SoC
# are WRONG by roughly 15x -- it reported "16.9 s" for a swap that took 237+ s
# by the host clock, because the bootloader's millisecond counter is calibrated
# for a different CPU frequency than it actually runs at. Time swaps from
# outside the device, never from the "I (nnnnn)" prefixes.
#
# swap-move needs one spare sector in the primary slot (it shifts the image up
# to make room): slot 0x150000 - 4096 = 1372160 B usable vs a ~1.28 MB image.
# The scratch partition is left in the DT but is unused in this mode.
SB_CONFIG_MCUBOOT_MODE_SWAP_USING_MOVE=y
```

## prj.conf
```kconfig
# --- Console / logging ---
CONFIG_PRINTK=y
CONFIG_LOG=y
CONFIG_CBPRINTF_FP_SUPPORT=y

# --- Console UART access for protocol I/O ---
CONFIG_SERIAL=y
CONFIG_UART_CONSOLE=y
CONFIG_CONSOLE=y

# Interrupt-driven RX. On a real UART (this board, unlike the C6's USB-CDC) the
# 128-byte FIFO holds ~11 ms at 115200 baud, so polling from the main loop drops
# bytes mid-line as soon as anything stalls it.
CONFIG_UART_INTERRUPT_DRIVEN=y
CONFIG_RING_BUFFER=y

# --- Board identity for the hello message ---
CONFIG_HWINFO=y

# --- Heap / stacks ---
CONFIG_MAIN_STACK_SIZE=8192
# A phone associating to the SoftAP is served by our custom DHCPv4 server (DNS +
# router options + unicast-OFFER ARP injection) which runs on the
# net_socket_service thread. Its 2400 B default stack overflowed on that path and
# corrupted kernel memory -> fatal fault in z_swap on the next context switch,
# crash-looping the board on every join (root cause pinned 2026-07-24 via
# STACK_SENTINEL, which named net_socket_service). 4096 B clears it with margin.
CONFIG_NET_SOCKETS_SERVICE_STACK_SIZE=4096
# Cheap insurance: turn a future stack overflow into a clean named reboot instead
# of silent memory corruption. THREAD_NAME makes the culprit legible in the dump.
CONFIG_THREAD_NAME=y
CONFIG_STACK_SENTINEL=y

# --- Display bring-up (CYD-T2 panel probe) ---
CONFIG_SPI=y
# Explicitly OFF, which is also the Kconfig default -- kept as a line rather
# than a deletion so nobody re-adds it for the reason we did.
#
# It was set on 2026-07-27 to "sleep on the transfer-complete interrupt instead
# of busy-polling". The driver does not do that. With it on, transceive() arms
# the interrupt and falls straight through to spi_context_release() --
# spi_esp32_spim.c has no spi_context_wait_for_completion() call, and
# CONFIG_SPI_ASYNC is off, so the spi_context_complete() the ISR performs only
# gives a semaphore nobody takes. Every synchronous transfer became
# fire-and-forget: XPT2046 read its RX buffer before the words landed (16
# averaged reads per touch report), and display_write() returned with DMA still
# reading the caller's strip.
#
# The busy-poll it was meant to remove survives either way -- the
# `while (!spi_hal_usr_is_done(hal))` spin is still there, just moved into the
# ISR. And that ISR is registered ESP_INTR_FLAG_IRAM while its CS teardown
# reaches gpio_esp32_port_clear_bits_raw in .flash.text, so it would fault if it
# fired during an NVS or OTA write, when the flash cache is down.
CONFIG_SPI_ESP32_INTERRUPT=n
CONFIG_GPIO=y
CONFIG_DISPLAY=y
CONFIG_MIPI_DBI=y
CONFIG_ILI9341=y
CONFIG_INPUT=y
CONFIG_INPUT_XPT2046=y

# --- LVGL ---
CONFIG_LVGL=y
CONFIG_LV_USE_LOG=y
CONFIG_LV_COLOR_DEPTH_16=y

# The QR on the setup screen. LVGL bundles Nayuki's qrcodegen, so this is a
# Kconfig switch rather than a vendored library -- see src/ui_qr.c for what
# it is for. Costs about 6 KB of flash and nothing at rest.
CONFIG_LV_USE_QRCODE=y
# The ILI9341 takes big-endian RGB565 over SPI; the ESP32 is little-endian.
CONFIG_LV_COLOR_16_SWAP=y
# 32 KiB: gauge screen + settings overlay + confirm dialog coexist, and every
# redraw allocates transient draw tasks on top. 16 KiB ran dry there and LVGL
# NULL-derefed (no graceful malloc-failure path in lv_draw_add_task).
# 30720 (was 32768): 2 KB went to the enlarged net_socket_service stack, which
# shares dram1 with this pool. Still ~2x the 16 KB that once ran dry on the gauge
# screen, so ample headroom remains.
# 48 KiB (was 30720). The three widget pages put ~40 more objects on the same
# screen - six launcher tiles with an icon and a label each, the transport's
# labels and buttons, two rails - and they live there even while hidden.
#
# The symptom was not a slow screen, it was a HARD CRASH: lv_draw_label.c:610
# writes through the buffer lv_draw_buf_create_ex just returned without
# checking it for NULL, so an exhausted pool is a CPU exception inside a glyph
# draw, five seconds after boot. Exactly what the 16 KiB note below describes,
# reached again from the other direction.
#
# Affordable: dram1 measured 54532 of 98304 bytes used at 30720, so this
# spends 18 KiB of a 43 KiB surplus and leaves ~25 KiB.
CONFIG_LV_Z_MEM_POOL_SIZE=49152
# dram0 is full (growing the pool past 16 KiB fails to link), but dram1 has
# ~46 KiB spare behind the noinit output section. A .noinit.* section name
# routes the pool there; sys_heap_init formats it, so no zero-init needed.
CONFIG_LV_Z_MEMORY_POOL_ZEPHYR_REGION=y
CONFIG_LV_Z_MEMORY_POOL_ZEPHYR_REGION_NAME=".noinit.lvgl_pool"
# The resistive panel's contact bounce fires a burst of INT edges at touch
# down/up, each producing a full XPT2046 report; a burst can exceed the queue
# within one 10 ms LVGL cycle and drop the button press/release -> missed taps
# (seen on hardware 2026-07-18: a single touch dropped dozens of events).
# The LVGL glue drains the whole msgq every lv_timer_handler pass
# (continue_reading), so a deeper queue only absorbs the burst -- no latency.
# DRAM is nearly full (256 overflowed dram1 by 14 KB, 128 by 2.8 KB): 96 is
# the most that fits, a 50% bump. A driver-level debounce is the real fix if
# this still drops.
CONFIG_INPUT_QUEUE_MAX_MSGS=96
CONFIG_LV_Z_POINTER_INPUT_MSGQ_COUNT=96
# Partial rendering, NOT a 150 KB framebuffer: there is no PSRAM, and WiFi +
# mbedTLS still have to fit in the same 520 KB.
#
# The buffer is 12288 B, not the 6144 this comment used to claim. LV_Z_VDB_SIZE
# is a percentage of the screen, but the Zephyr glue turns it into bytes with
# LV_Z_BITS_PER_PIXEL (modules/lvgl/lvgl.c, BUFFER_SIZE), and that Kconfig lists
# an unconditional `default 32` BEFORE `default 16 if LV_COLOR_DEPTH_16` --
# first default wins, so it is 32 here despite our 16-bit colour.
# 32 * (4 * 320 * 240 / 100) / 8 = 12288, confirmed as .bss.buf0_0 = 0x3000.
#
# Nearly all of it is used: the full byte count goes to lv_display_set_buffers,
# which floors it to whole rows (12288 / 640 B stride = 19 rows), so LVGL renders
# 6080 RGB565 pixels per pass -- 8% of the screen, and ~13 render-and-flush passes
# for a full redraw, not 25. The ~128 B remainder is the row-alignment offcut.
#
# Setting CONFIG_LV_Z_BITS_PER_PIXEL=16 would make the number mean what it says
# and hand ~6 KB back, which is worth remembering: measured 2026-07-26, free
# DRAM is ~3.3 KB in dram0 (__bss_end 0x3ffdf300 vs heap sentry 0x3ffe0000)
# plus ~0.4 KB in dram1. It would also halve the flush chunk and double the
# pass count, so it is a lever for when DRAM gets tight, not a fix.
CONFIG_LV_Z_VDB_SIZE=4
# LVGL's own frame gate. The default 33 ms caps everything at 30 FPS, which is
# irrelevant to a full-screen redraw (124 ms, bounded elsewhere) but does bind
# on the cheap partial redraws, which measure ~5 ms.
#
# 16 does NOT buy a 16 ms period. The repeating lv_timer_handler() call sites
# here sit in loops that sleep between passes -- 10 ms in main.c's mode loops
# and wifi_settle, 5 ms in ui_anim.c and in ui_boot's clip playback -- so LVGL
# is never asked to refresh more often than that, and a 16 ms gate lands on
# the first pass that crosses it: ~20 ms either way. Real, but half what the
# number suggests.
#
# It does nothing for the countdown digits: usage_view_tick_1s() is called
# behind a `now - last_tick >= 1000` guard, so that text changes at 1 Hz no
# matter what this is set to.
CONFIG_LV_DEF_REFR_PERIOD=16
CONFIG_LV_USE_ARC=y
CONFIG_LV_USE_SPINNER=y
CONFIG_LV_USE_BUTTON=y
CONFIG_LV_USE_LABEL=y
# The launcher's app icons. This build opts widgets in one at a time, so the
# image widget is absent unless asked for -- and its absence shows up as a
# link error for lv_image_create, not as a blank tile.
#
# The icon data is `const` (src/icons_gen.h, 28 KB) so it lives in flash, not
# in the DRAM this file spends three comments being careful about. An
# lv_image whose source is a flash descriptor draws straight from it; nothing
# is copied into the LVGL pool.
CONFIG_LV_USE_IMAGE=y
CONFIG_LV_FONT_MONTSERRAT_20=y
CONFIG_LV_Z_POINTER_INPUT=y

# --- Networking ---
#
# The WiFi driver, the IP stack, TLS and the HTTP client used to live here and
# were built into every image. They now live in wifi.conf and are pulled in
# only by CONFIG_OVERWATCH_WIFI_MODE, because a USB-only unit needs none of them:
# the daemon on the customer's machine supplies usage, time and firmware, and
# a radio that is never used is still flash, still RAM, and still the OAuth
# client id and refresh token sitting in a shipped binary.
#
#   west build ... -- -DEXTRA_CONF_FILE=wifi.conf     (to get them back)

# --- Config store, and the bits the display path needs ---
#
# These sat inside the old "Networking" block and moved out with it, which
# broke a USB-only build in ways that had nothing to do with the radio:
# IMG_MANAGER (OTA) depends on FLASH_MAP, and the backlight is a PWM. They
# belong to the board, not to WiFi. wifi.conf still sets the same values, and
# an identical assignment in both files is harmless.
#
# cfg_store is NOT settings/NVS: NVS needs erased flash to read as 0xFF, and
# with flash encryption on, erased sectors read as decrypt-garbage. It keeps
# its own A/B CRC-sealed record in the storage partition instead.
CONFIG_FLASH=y
CONFIG_FLASH_MAP=y
CONFIG_CRC=y
CONFIG_REBOOT=y
CONFIG_PWM=y
CONFIG_ESP_FLASH_ENCRYPTION=y
CONFIG_ZVFS_OPEN_MAX=16
CONFIG_LV_FONT_MONTSERRAT_14=y
CONFIG_LV_FONT_MONTSERRAT_16=y
# Sized for the WiFi build, where the driver and mbedTLS share this pool. A
# USB-only image has neither and could almost certainly run on far less --
# worth measuring before trimming, since getting it wrong shows up as an
# allocation failure deep in a driver rather than as a build error.
CONFIG_HEAP_MEM_POOL_SIZE=86016

# --- Hashing for the OTA image check ---
#
# NOT the TLS stack, which lives in wifi.conf. ota.c verifies a streamed image
# against the manifest's sha256, and main.c routes mbedTLS's allocator at the
# kernel heap; both need mbedTLS present, neither needs a handshake. A hash
# brings no client id, no certificate and no network.
CONFIG_MBEDTLS=y
CONFIG_MBEDTLS_BUILTIN=y

# --- OTA: image management + slot1 streaming ---
CONFIG_IMG_MANAGER=y
CONFIG_MCUBOOT_BOOTUTIL_LIB=y
CONFIG_STREAM_FLASH=y
CONFIG_IMG_ERASE_PROGRESSIVELY=y
CONFIG_LV_USE_BAR=y
# OTA test boots arm the hardware watchdog: a hard-hung update image stops
# feeding, the chip resets, and MCUboot reverts to the previous version.
CONFIG_WATCHDOG=y
```

## pilot.conf
```kconfig
# Build for one of the two pilot (POC) boards rather than the production batch.
#
#   west build -b esp32_devkitc/esp32/procpu . -- -DEXTRA_CONF_FILE=pilot.conf
#
# Their display modules differ: see OVERWATCH_PANEL_PILOT in Kconfig. Flashing a
# stock (production) build to a pilot leaves it mirrored, red/blue swapped and
# dim -- and the reverse is equally wrong, so pick deliberately, per board.
CONFIG_OVERWATCH_PANEL_PILOT=y
```

## trace.conf
```kconfig
# Touch-trace diagnostic build. Layered on prj.conf via
# -Dfirmware_EXTRA_CONF_FILE=trace.conf; pair with trace.overlay.
CONFIG_OVERWATCH_TOUCH_TRACE=y

# The dump printk()s from the input thread, whose default 1024 B stack is sized
# for callbacks that only forward events.
CONFIG_INPUT_THREAD_STACK_SIZE=2048

# The tracer's 1.5 KB ring plus the bigger input stack overflow dram1_0_seg by
# 612 B -- that segment is ~99% full in a release build. The LVGL pool lives in
# the same segment (.noinit.lvgl_pool), so give 3 KB of it back for the
# duration of the trace. 27648 is still well above the 16384 that once ran the
# gauge screen dry, and this file is never part of a release build.
CONFIG_LV_Z_MEM_POOL_SIZE=27648
```

## wifi.conf
```kconfig
# Standalone WiFi mode: the board fetches its own usage over the air.
#
# NOT part of a default build. Everything here exists to support
# CONFIG_OVERWATCH_WIFI_MODE, which is default n -- see firmware/Kconfig for why.
# Enable the whole thing with:
#
#   west build --sysbuild -d build-sb -b esp32_devkitc/esp32/procpu . \
#     -- -DEXTRA_CONF_FILE=wifi.conf
#
# Keep this file and the Kconfig symbol in step: the symbol decides which
# SOURCES compile, this decides which Zephyr subsystems exist for them to call.
CONFIG_OVERWATCH_WIFI_MODE=y

# --- Networking: WiFi + TLS (standalone mode) ---
CONFIG_WIFI=y
CONFIG_WIFI_ESP32=y
# Without AP_STA_MODE the driver never creates a soft-AP net_if: the AP
# broadcasts, a phone associates, and then nothing answers its DHCP request --
# it just spins on "obtaining IP address" forever. Requires the WiFi network
# manager.
CONFIG_ESP32_WIFI_AP_STA_MODE=y
CONFIG_WIFI_NM=y
CONFIG_WIFI_NM_MAX_MANAGED_INTERFACES=2
# Defense-in-depth for the tight WiFi/system heap: a station associating to the
# SoftAP opens a BlockAck session whose RX_BA_WIN-sized reorder queue is allocated
# from that heap. AMPDU aggregation is a pure-throughput feature this once-a-minute
# usage display never needs, so turning it off drops that per-station allocation
# and eases heap pressure. (The actual join crash was a net_socket_service stack
# overflow + heap OOM, fixed above/below; this just keeps more slack.)
CONFIG_ESP32_WIFI_AMPDU_TX_ENABLED=n
CONFIG_ESP32_WIFI_AMPDU_RX_ENABLED=n
CONFIG_NETWORKING=y
CONFIG_NET_IPV4=y
# Two interfaces (station + soft-AP) means two IPv4 contexts. This defaults to
# 1, and with only one the AP interface silently fails to take an address --
# net_if_ipv4_addr_add() just returns NULL.
CONFIG_NET_IF_MAX_IPV4_COUNT=2
CONFIG_NET_IPV6=n
CONFIG_NET_DHCPV4=y
CONFIG_NET_DHCPV4_SERVER=y
# Hand out OURSELVES as the DNS server. Zephyr's default points somewhere else
# entirely, and with the wrong DNS the phone's captive-portal probe never
# reaches us: the OS decides "no internet" instead of "behind a portal" and
# quietly falls back to cellular without ever showing the setup page.
CONFIG_NET_DHCPV4_SERVER_OPTION_DNS_ADDRESS="192.168.4.1"
# Send the router (default gateway) option. OFF by default, but iOS REFUSES a
# DHCP lease that has no router option and spins on "obtaining IP" forever --
# macOS accepts it, which is why the Mac got an address and the iPhone did not.
CONFIG_NET_DHCPV4_SERVER_OPTION_ROUTER=y
# iOS usually does NOT set the DHCP broadcast flag, so the server unicasts its
# OFFER to the phone's MAC and must inject an ARP entry to do it. The default
# ARP table holds only 2 entries -- too small to reliably keep that mapping.
CONFIG_NET_ARP_TABLE_SIZE=16
# Kill the pre-offer ICMP probe: it adds a 1s stall per offer (long enough for
# iOS's DHCP client to give up and retry) and buys us nothing on a private
# 8-address pool we fully control.
CONFIG_NET_DHCPV4_SERVER_ICMP_PROBE_TIMEOUT=0
# Bigger pool + short lease. Phones use a ROTATING private MAC, so every
# "forget and rejoin" during setup looks like a brand-new client. With the
# default of 4 addresses and a 24h lease, a few retries exhaust the pool and
# the board stops offering addresses -- the phone then just spins on
# "obtaining IP". A short lease lets stale reservations expire in minutes.
CONFIG_NET_DHCPV4_SERVER_ADDR_COUNT=8
CONFIG_NET_DHCPV4_SERVER_ADDR_LEASE_TIME=300
CONFIG_NET_TCP=y
CONFIG_NET_SOCKETS=y
# Connection/fd budget. Defaults are too small for what we run concurrently:
# the DHCP server, the DNS hijack socket, the TCP listener AND an accepted
# connection all need slots. At the default NET_MAX_CONN=4 incoming TCP is
# simply dropped -- ping works, HTTP does not.
CONFIG_NET_MAX_CONN=8
CONFIG_NET_MAX_CONTEXTS=10
CONFIG_ZVFS_OPEN_MAX=16
CONFIG_NET_SOCKETS_POLL_MAX=4
CONFIG_NET_SOCKETS_SOCKOPT_TLS=y
CONFIG_NET_L2_ETHERNET=y
# NOT NET_CONFIG_SETTINGS/AUTO_INIT: it blocks at boot waiting for the iface to
# acquire an IPv4 address, which never happens before we have credentials -- it
# stalled main() entirely. We bring WiFi up ourselves.
CONFIG_NET_CONFIG_SETTINGS=y
CONFIG_NET_CONFIG_AUTO_INIT=n
CONFIG_NET_MGMT=y
CONFIG_NET_MGMT_EVENT=y
CONFIG_DNS_RESOLVER=y
CONFIG_SNTP=y

# --- TLS ---
CONFIG_MBEDTLS=y
CONFIG_MBEDTLS_BUILTIN=y
# NOT the Zephyr static heap. CONFIG_MBEDTLS_ENABLE_HEAP=y reserves
# `static unsigned char _mbedtls_heap[CONFIG_MBEDTLS_HEAP_SIZE]`
# (modules/mbedtls/zephyr_init.c:37) for TLS whether TLS is running or not,
# while HEAP_MEM_POOL_SIZE separately reserves a worst case for WiFi. Two
# static worst cases do not fit on this chip: ~6 KB was free across dram0+dram1
# with mbedTLS at 32000, which is too little for the OTA download's 16 KB
# record buffer AND the release CDN's all-RSA certificate chain.
#
# The two peaks never coincide -- TLS is idle during provisioning, and the
# SoftAP is down in standalone mode when OTA runs -- so main.c points mbedTLS
# at the kernel heap (mbedtls_platform_set_calloc_free) and ONE pool sized to
# the larger peak replaces two sized to their sum.
#
# With ENABLE_HEAP=n, mbedTLS would otherwise fall back to libc calloc, and
# picolibc's heap here is ~5 KB ("libc heap size 5 kB" at boot) -- far too
# small. main.c's override is therefore load-bearing, not an optimisation.
CONFIG_MBEDTLS_ENABLE_HEAP=n
# Unused while ENABLE_HEAP=n (no static _mbedtls_heap is allocated); kept so a
# future revert to the static heap does not silently land on the Kconfig
# default. History, since it cost real hardware time to establish: with the
# static heap and pool at 55296, 32000 truncated the release CDN's all-RSA
# chain mid-parse (update check failed x509 -0x2700), 36000 linked but
# misbehaved (bogus HTTP status 618), and 40000 -- the smallest value that
# actually worked -- did not fit at all, overflowing dram0 by 1968 B.
CONFIG_MBEDTLS_HEAP_SIZE=32000
# Baseline for both record buffers, but src/mbedtls_user_config.h OVERRIDES
# them asymmetrically (IN=16384, OUT=2048). Zephyr maps this one symbol to
# both MBEDTLS_SSL_IN_CONTENT_LEN and _OUT_CONTENT_LEN, and inbound has to be
# 16384 -- the TLS maximum -- because GitHub's release CDN ramps to full-size
# records once a download passes ~32 KB. Outbound never needs more than a GET.
CONFIG_MBEDTLS_SSL_MAX_CONTENT_LEN=6144
CONFIG_MBEDTLS_USER_CONFIG_ENABLE=y
CONFIG_MBEDTLS_USER_CONFIG_FILE="mbedtls_user_config.h"
# Config store: NOT settings/NVS. NVS needs erased flash to read as 0xFF,
# and with flash encryption enabled erased sectors read as decrypt-garbage
# (mount died with -EDEADLK on hardware, 2026-07-17; ESP-IDF exempts NVS
# from flash encryption for the same reason). cfg_store keeps its own A/B
# CRC-sealed record in the storage partition instead -- garbage-means-empty
# is by design there. CRC for the record seal.
CONFIG_FLASH=y
CONFIG_FLASH_MAP=y
CONFIG_CRC=y
# This IS the heap the ESP32 WiFi driver allocates from (k_malloc-backed
# _system_heap; the esp heap_caps path is a stub here). A phone associating to
# the SoftAP allocates per-station buffers from it, and provisioning idle left
# only ~8.8 KB free -- the alloc failed ("esp32_wifi_adapter: memory allocation
# failed") and the driver then corrupted kernel memory into a fatal z_swap crash
# (measured 2026-07-24).
#
# The effective pool size is max(this, sum of HEAP_MEM_POOL_ADD_SIZE_* floors).
# The WiFi(40 KB)+board(4 KB)+getaddrinfo adds already floor it at ~45 KB, so any
# value below that (the old 16384) does NOTHING. Set ABOVE the floor to actually
# grow it: 55296 bought ~10 KB of real headroom (free ~8.8 -> ~19 KB), plenty for
# a station join (measured dipping only to ~17 KB).
#
# Since ENABLE_HEAP=n this pool is now ALSO the mbedTLS heap (main.c routes
# mbedtls_calloc here), so it must additionally cover a TLS session: an 16 KB
# inbound record buffer + 2 KB outbound + the peer certificate chain, ~20-25 KB
# for the OTA download, which is the heaviest user. Sized for the larger of the
# two peaks rather than their sum, which is the whole point -- they never
# overlap, as the SoftAP is down whenever OTA runs. 86016 replaces the old
# 55296 + 32000 static pair and still leaves dram0 headroom.
CONFIG_HEAP_MEM_POOL_SIZE=86016
# Packet pools. Trimmed once to 8/16 to save DRAM -- that was too far: a phone
# joining the SoftAP sprays small mDNS/discovery packets, the RX pool drains,
# and the TCP stack freezes at ESTABLISHED and never recovers (the known
# failure mode of zephyr#45426 / #55671: allocation stalls inside the stack).
# Verified on this hardware: handshake completed, then the whole RX path died.
# RX-heavy on purpose; inbound flood is the pressure source.
CONFIG_NET_BUF_RX_COUNT=28
# TX pool sized so a retransmission can ALWAYS allocate: Zephyr TCP clones
# the segment on resend, and with a ~2 KB portal page pinning 16 of 20 bufs a
# single frame lost on air could never be retransmitted -- the stack logged
# "TCP failed to allocate buffer in retransmission" and killed the
# connection (root cause of the captive-portal white pages, 2026-07-16).
CONFIG_NET_BUF_TX_COUNT=40
CONFIG_NET_PKT_RX_COUNT=14
CONFIG_NET_PKT_TX_COUNT=16
CONFIG_LV_USE_QRCODE=y
CONFIG_LV_USE_TEXTAREA=y
CONFIG_LV_FONT_MONTSERRAT_14=y
CONFIG_LV_FONT_MONTSERRAT_16=y
# --- HTTP client for OAuth token calls + usage fetch ---
CONFIG_HTTP_CLIENT=y
CONFIG_DNS_RESOLVER=y
CONFIG_REBOOT=y



# This board's 3.3V rail sags under full-power radio bursts (observed:
# POWERON_RESETs at the moment a station associates, join handshakes timing
# out while scans work, and occasional boots with a blind radio). 11 dBm
# roughly quarters the peak PA current vs 20 dBm and is plenty for same-room
# provisioning and home-router range.
CONFIG_ESP32_PHY_MAX_TX_POWER=11

# Make SO_SNDTIMEO real: without this a UDP sendto blocks forever on buffer
# starvation, which is how the DNS hijack thread got wedged (its teardown
# then needs k_thread_abort and leaks the socket).
CONFIG_NET_CONTEXT_SNDTIMEO=y
# Same story for SO_RCVTIMEO: tz_fetch sets an 8 s recv timeout that was
# silently a no-op without this -- a stalled HTTP server would park the whole
# standalone loop (UI included) in recv() forever.
CONFIG_NET_CONTEXT_RCVTIMEO=y
# The default 3 s connect budget is a razor edge for TLS over a cellular
# hotspot: higher RTT, a ~6 KB certificate flight in 536-byte segments (MTU
# 576), and 1-2 s of ECDHE math on this CPU. The OAuth exchange timed out
# with -116 twice on an iPhone hotspot (2026-07-15) while the same exchange
# passed on hotel WiFi.
CONFIG_NET_SOCKETS_CONNECT_TIMEOUT=20000

# Both Anthropic endpoints serve all-ECDSA chains (P-384 roots, SHA-384
# signatures) behind CDNs that only offer ECDHE + AEAD suites. Without these,
# every TLS handshake fails at connect() -- discovered the first time the
# OAuth exchange ran on hardware (2026-07-14).
CONFIG_MBEDTLS_ECP_C=y
CONFIG_MBEDTLS_ECDH_C=y
CONFIG_MBEDTLS_ECDSA_C=y
CONFIG_MBEDTLS_ECP_DP_SECP256R1_ENABLED=y
CONFIG_MBEDTLS_ECP_DP_SECP384R1_ENABLED=y
CONFIG_MBEDTLS_ECP_DP_CURVE25519_ENABLED=y
CONFIG_MBEDTLS_KEY_EXCHANGE_ECDHE_ECDSA_ENABLED=y
CONFIG_MBEDTLS_KEY_EXCHANGE_ECDHE_RSA_ENABLED=y
CONFIG_MBEDTLS_SHA384=y
CONFIG_MBEDTLS_CIPHER_GCM_ENABLED=y

# TEMPORARY diagnostics: mbedTLS handshake tracing for the -113 abort.
CONFIG_MBEDTLS_DEBUG=y
CONFIG_MBEDTLS_LOG_LEVEL_ERR=y

# Send SNI in the ClientHello. Compiled out, mbedTLS keeps the hostname only
# for local cert checks; Cloudflare-fronted hosts (console.anthropic.com)
# refuse SNI-less handshakes with alert 40 before ciphers are even weighed.
CONFIG_MBEDTLS_SERVER_NAME_INDICATION=y
# The embedded root CAs (certs.h) are PEM text; without PEM support mbedTLS
# holds zero trusted CAs and every verify fails with "got no CA chain".
CONFIG_MBEDTLS_PEM_CERTIFICATE_FORMAT=y
# NIST-curve optimized arithmetic: the software P-384 handshake takes ~67 s
# without it and the peer gives up (-ETIMEDOUT). This is the single largest
# ECC speedup available in software.
CONFIG_MBEDTLS_ECP_NIST_OPTIM=y


# Backlight dimming: the TFT backlight pin (GPIO21) runs on LEDC PWM so
# night mode can dim it; a bare GPIO only offered blinding or blank.
CONFIG_PWM=y

# Flash-encryption compatibility (with the MCUboot boot chain): the flash
# driver routes reads/writes through the encrypted paths once the eFuses
# enable encryption; harmless (virtual) before that.
CONFIG_ESP_FLASH_ENCRYPTION=y
```

## wired.conf
```kconfig
# Panel settings for the discrete KMRTM28028-SPI module on jumper wires,
# rather than the CYD's soldered-on panel.
#
#   west build ... -- ... -DEXTRA_CONF_FILE=wired.conf
#
# The firmware ships expecting the CYD's PRODUCTION panel, which renders
# mirrored and is wired RGB, so main.c re-issues MADCTL as MV|MY with the BGR
# bit cleared to compensate. This module needs none of that: measured on
# hardware 2026-09-23, it rendered MIRRORED with that correction applied, and
# rotating the board 180 degrees did not undo it - which is what rules out a
# rotation and leaves the mirror.
#
# OVERWATCH_PANEL_PILOT compiles the correction away entirely, leaving the stock
# rotation=90 MADCTL the ili9xxx driver writes (BGR|MV). It also takes the
# backlight scale back to 100%, which is what this module wants anyway: it has
# no transistor driving it, just an ESP32 pin, so it has less light to give
# than the CYD's panel, not more.
#
# If the colours come out wrong after this - anything that should be red
# reading blue - the flag has gone one step too far: this panel would then be
# wired RGB like the production batch, and the fix is a custom MADCTL of MV
# alone with the BGR bit cleared, rather than either preset.
CONFIG_OVERWATCH_PANEL_PILOT=y
```

## boards/wired.overlay
```dts
/*
 * Discrete ESP32 DevKitC + a separate 2.8" SPI panel on jumper wires,
 * instead of the CYD's single PCB.
 *
 *   west build ... -- ... -DEXTRA_DTC_OVERLAY_FILE=boards/wired.overlay
 *
 * The CYD pin map is unchanged and does not need to be: the panel is wired to
 * the pins the firmware already expects. This file changes one thing, and it
 * is the one thing a breadboard changes.
 *
 * SPI CLOCK. The CYD runs the panel at 32 MHz, measured on ITS PCB - short
 * controlled-impedance traces with a ground plane under them. A 20 cm Dupont
 * jumper has none of that, and at 32 MHz the panel either latches garbage or
 * never latches its init at all - which looks exactly like the solid white
 * screen a 40 MHz overclock gives on a real CYD.
 *
 * Start at 10 MHz, then walk it up (16, then 20) and stop one step below
 * wherever it breaks.
 */

&ili9341 {
	mipi-max-frequency = <10000000>;
};

/*
 * TOUCH: both axes inverted relative to the CYD.
 *
 * Measured 2026-09-23 with the touch echo (ui_touchfx.c): a tap on the
 * top-left bloomed bottom-right, a tap on the top-right bloomed bottom-left.
 * Diagonally opposite on both, which is a 180 degree turn of the touch plane,
 * not a scale or offset error.
 *
 * Why it moved: the CYD overlay's `invert-x` was fitted against the
 * PRODUCTION panel's MADCTL (MV|MY). wired.conf takes this module down the
 * pilot path, which leaves the driver's own MADCTL (MV) - so the display's
 * row order flipped and the mapping that was solved against the old one no
 * longer holds.
 *
 * Toggling BOTH flags is the whole correction, and it does not matter that
 * the overlay warns these apply before the ROTATED_90 compensation: inverting
 * both axes is a 180 degree rotation, and rotations commute, so it lands the
 * same either side of the compensation.
 */
/ {
	lvgl_pointer {
		/delete-property/ invert-x;
		invert-y;
	};
};
```

## src/backlight.c
```c
/*
 * Screen backlight: a manual brightness level the user sets in settings.
 *
 * Owns the LEDC PWM and the current percent. There is no automatic schedule --
 * the level is loaded at boot and only ever changes when the user steps it.
 */
#include <zephyr/kernel.h>
#include <zephyr/drivers/pwm.h>
#include <zephyr/sys/printk.h>

#include "backlight.h"
#include "cfg_store.h"

static const struct pwm_dt_spec bl = PWM_DT_SPEC_GET(DT_NODELABEL(backlight));
static uint8_t level = 100;	/* percent; real value loaded in backlight_init */

/*
 * Production-panel brightness calibration.
 *
 * The production batch is far brighter than the pilot units at the same PWM
 * duty -- compared side by side at an identical 80% setting on 2026-08-21, the
 * new panel had to be stepped down before it matched. Different backlight LEDs
 * or panel transmissivity; nothing to do with the pixel data.
 *
 * Scaling the duty rather than lowering the default keeps a given percent
 * meaning the same amount of light on either batch, and leaves the user the
 * full 20..100 range instead of shrinking it. The factor is OVERWATCH_BL_SCALE_PCT
 * (100 on pilot builds, so they are unaffected) -- tune it by eye.
 *
 * The multiply is 64-bit on purpose: period is in nanoseconds (1 ms at the
 * 1 kHz in the overlay = 1e6), and 1e6 * 100 * 60 overflows 32 bits.
 */

static void apply(void)
{
	if (!pwm_is_ready_dt(&bl)) {
		return;
	}
	printk("[bl] %d%%\n", level);
	pwm_set_pulse_dt(&bl, (uint32_t)((uint64_t)bl.period * level *
					  CONFIG_OVERWATCH_BL_SCALE_PCT / 10000U));
}

void backlight_init(void)
{
	level = cfg_get_bright_pct();
	apply();
}

void backlight_step(int dir)
{
	uint8_t next = backlight_next_level(level, dir);

	if (next == level) {
		return;		/* already at an end */
	}
	level = next;
	cfg_set_bright_pct(level);
	apply();
}

void backlight_set(uint8_t pct)
{
	/* Snap rather than trust the caller: the levels are a fixed set, and a
	 * value off the scale would persist and come back at the next boot as
	 * a brightness the UI has no way to represent. */
	int v = ((int)pct + 10) / 20 * 20;

	if (v < 20) {
		v = 20;
	}
	if (v > 100) {
		v = 100;
	}
	if ((uint8_t)v == level) {
		return;
	}
	level = (uint8_t)v;
	cfg_set_bright_pct(level);
	apply();
}

uint8_t backlight_get(void)
{
	return level;
}
```

## src/cfg_store.h
```c
#ifndef CFG_STORE_H
#define CFG_STORE_H

#include <stddef.h>
#include <stdbool.h>
#include <stdint.h>

/* Where the board gets its numbers from. Persisted, so the choice survives a
 * power cycle -- being asked again on every boot would make it a worse device.
 */
enum cfg_mode {
	CFG_MODE_UNSET = 0,
	CFG_MODE_USB,		/* PC daemon pushes usage over serial */
	CFG_MODE_WIFI,		/* board fetches usage itself */
};

#define CFG_SSID_MAX 33		/* 32 + NUL */
#define CFG_PSK_MAX 65		/* 64 + NUL */
#define CFG_TOKEN_MAX 320	/* OAuth refresh tokens are long */

int cfg_init(void);

enum cfg_mode cfg_get_mode(void);
int cfg_set_mode(enum cfg_mode mode);

/* WiFi credentials. cfg_get_wifi() returns false if none are stored. */
bool cfg_get_wifi(char *ssid, size_t ssid_len, char *psk, size_t psk_len);
int cfg_set_wifi(const char *ssid, const char *psk);

/*
 * The OAuth refresh token.
 *
 * Stored separately from the WiFi credentials on purpose: when the token is
 * rejected and the user has to sign in again, we clear ONLY the token and keep
 * them on their network -- one pasted code, not a full re-provision.
 *
 * Secret. Never logged.
 */
bool cfg_get_token(char *tok, size_t len);
int cfg_set_token(const char *tok);
int cfg_clear_token(void);

/* Clear ONLY the WiFi credentials (settings-screen "Reset WiFi"): the token
 * survives, so after re-provisioning the network the gauges come back without
 * another sign-in. */
int cfg_clear_wifi(void);

#define CFG_AP_PSK_MAX 17	/* 16 + NUL; generated ones are 10 chars */

/* The setup AP's WPA2 password: random, generated once at first boot and
 * stable thereafter, so a printed/remembered QR keeps working. Rides in the
 * join QR, never typed. cfg_get_ap_psk() returns false until one is stored.
 * Cleared only by factory reset (a new one is generated on the next boot). */
bool cfg_get_ap_psk(char *psk, size_t len);
int cfg_set_ap_psk(const char *psk);

/* Which window the weekly gauge shows (0 = all models, 1 = fable): the
 * peek-card choice, persisted so a reboot keeps it. Defaults to 0. */
uint8_t cfg_get_weekly_sel(void);
int cfg_set_weekly_sel(uint8_t sel);

/*
 * Which provider the panel treats as primary -- the outer ring, the big
 * number, the first countdown.
 *
 * Kept on the DEVICE rather than in the daemon because it is the device the
 * user is looking at when they decide, and because a preference that resets
 * every time the daemon restarts is not a preference. The board announces it
 * to the host, which is what actually acts on it.
 */
enum cfg_main_src {
	CFG_MAIN_SRC_CLAUDE = 0,	/* also the value an unset record reads as */
	CFG_MAIN_SRC_CODEX = 1,
};

uint8_t cfg_get_main_src(void);
int cfg_set_main_src(uint8_t src);

/* Screen brightness percent, one of 20/40/60/80/100. Persisted so a reboot
 * keeps it. Returns 100 when never set (a fresh or pre-update device). */
/* Dark theme. 0/unset is light, which is the default a new board lands on. */
bool cfg_get_dark(void);
int cfg_set_dark(bool dark);

uint8_t cfg_get_bright_pct(void);
int cfg_set_bright_pct(uint8_t pct);

/* Last known UTC offset (minutes east of UTC), fed by the tz API in WiFi mode
 * so the clock survives API outages. cfg_get_tz() returns false until an
 * offset has ever been stored. */
bool cfg_get_tz(int32_t *offset_min);
int cfg_set_tz(int32_t offset_min);

#define CFG_OTA_VER_MAX 16	/* "MAJOR.MINOR.PATCH" + NUL, with headroom */

/* OTA handshake across the update reboot: state 1 + target version are
 * written just before rebooting into a new image; the next boot compares the
 * running version to the target to report success or revert. */
uint8_t cfg_get_ota_state(char *ver, size_t len);
int cfg_set_ota_state(uint8_t st, const char *ver);

/* Wipe everything (factory reset). */
int cfg_reset(void);


/*
 * Which edition this unit is: which boot clip it plays.
 *
 * A FACTORY fact, not a preference. It is written once over USB after the
 * board is programmed (`overwatch provision --edition codex`) and there is
 * deliberately no way to reach it from the settings screen -- the enclosure
 * decides it, and a user who could flip it would only be putting the wrong
 * animation in the wrong box.
 *
 * Living on the unit rather than in the binary is what keeps ONE firmware
 * image for both editions. The alternative was a second build, which forks
 * the OTA feed: the manifest names one firmware and `hello` carries no
 * edition, so a Codex unit would be offered the Claude image and would take
 * it -- its identity reverting silently, in the field, months later. Both
 * clips are compiled in instead and this picks between them at boot. The
 * second one costs 17 KB on an image using 663 KB of 4 MB.
 *
 * 0 is Claude, so an unset record -- every unit built before this existed --
 * reads as the edition that was already shipping.
 *
 * WRITE ONCE. The first successful cfg_set_edition() latches the record, and
 * every later one is refused with -EPERM. "No way to reach it from the
 * settings screen" was not enough: the message that stamps it arrives over
 * USB from whatever is on the other end of the cable, and the CLI that sends
 * it is the same binary the user installs. Without the latch, anyone who owns
 * a unit owns `overwatch provision`, and the enclosure and the animation inside
 * it stop agreeing.
 *
 * The latch also survives cfg_reset(). A factory reset wipes what the USER
 * put on the device -- network, token, preferences -- and the edition is not
 * that. It is a property of the box the board is screwed into, and a reset
 * that cleared it would be a second route to the same change, reachable from
 * the settings menu with no computer involved at all.
 *
 * What remains is erasing the config partition with esptool over USB, with
 * the board held in bootloader mode. That is a factory operation by
 * construction, which is the boundary that was wanted.
 */
enum cfg_edition {
	CFG_EDITION_CLAUDE = 0,
	CFG_EDITION_CODEX = 1,
};

uint8_t cfg_get_edition(void);

/* Whether this unit has already been stamped. Provisioning tools ask first so
 * they can say "already a codex unit" instead of reporting a bare failure. */
bool cfg_edition_locked(void);

/*
 * Stamp the edition. Returns -EPERM if this unit was already stamped, and
 * -EINVAL for an edition this firmware does not know.
 */
int cfg_set_edition(uint8_t edition);

#endif /* CFG_STORE_H */
```

## src/net_time.c
```c
/*
 * SNTP wall-clock sync + ISO-8601 -> seconds-remaining.
 *
 * Two jobs, both needed only in standalone WiFi mode: give mbedTLS a real time
 * so certificate validity checks pass, and let the board turn the API's
 * absolute resets_at timestamps into live countdowns itself (over USB the PC
 * does this instead).
 */
#include <zephyr/kernel.h>
#if IS_ENABLED(CONFIG_OVERWATCH_WIFI_MODE)
#include <zephyr/net/sntp.h>
#endif
#include <zephyr/sys/timeutil.h>
#include <zephyr/sys/printk.h>
#include <string.h>
#include <time.h>

#include "net_time.h"
#include "version.h"

/* Sanity window for any accepted time source. The floor blocks the
 * clock-rollback certificate attack (see OVERWATCH_TIME_FLOOR); the ceiling
 * matches the protocol's "before 2100" bound and catches garbage. */
#define TIME_CEILING 4102444800LL	/* 2100-01-01T00:00:00Z */

static bool time_sane(int64_t unix_s)
{
	return unix_s >= OVERWATCH_TIME_FLOOR && unix_s < TIME_CEILING;
}

static bool have_time;
/* Uptime (ms) at the moment of sync, and the Unix time then, so we can read the
 * current wall time without depending on a POSIX clock backend. */
static int64_t sync_uptime_ms;
static int64_t sync_unix_s;

static bool have_offset;
static int32_t offset_min;

/* The standalone net worker syncs/adjusts time while the UI thread reads the
 * clock every second. The base is a 64-bit pair -- not atomic on this core --
 * so reads and writes go through a spinlock (held for nanoseconds). */
static struct k_spinlock time_lock;

#if IS_ENABLED(CONFIG_OVERWATCH_WIFI_MODE)
/* The only part of this file that needs a network. The rest -- set_manual,
 * set_offset, local, secs_until -- is arithmetic on a clock the daemon sets
 * over USB, and is what a tethered board actually uses. */
int net_time_sync(int timeout_s)
{
	struct sntp_time t;
	const char *servers[] = { "pool.ntp.org", "time.google.com", "time.cloudflare.com" };

	for (int i = 0; i < 3; i++) {
		int rc = sntp_simple(servers[i], timeout_s * 1000, &t);

		if (rc == 0 && !time_sane((int64_t)t.seconds)) {
			/* A "successful" sync outside the sane window is
			 * worse than none: TLS would then trust certificates
			 * against a lie. Try the next server. */
			printk("[time] %s answered insane time %lld; rejected\n",
			       servers[i], (long long)t.seconds);
			rc = -EINVAL;
		}
		if (rc == 0) {
			k_spinlock_key_t key = k_spin_lock(&time_lock);

			sync_unix_s = (int64_t)t.seconds;
			sync_uptime_ms = k_uptime_get();
			have_time = true;
			k_spin_unlock(&time_lock, key);
			printk("[time] synced via %s (unix %lld)\n", servers[i],
			       (long long)sync_unix_s);
			return 0;
		}
		printk("[time] %s failed: %d\n", servers[i], rc);
	}
	return -ETIMEDOUT;
}
#endif /* CONFIG_OVERWATCH_WIFI_MODE */

bool net_time_valid(void)
{
	return have_time;
}

static int64_t now_unix(void)
{
	k_spinlock_key_t key = k_spin_lock(&time_lock);
	int64_t v = sync_unix_s + (k_uptime_get() - sync_uptime_ms) / 1000;

	k_spin_unlock(&time_lock, key);
	return v;
}

void net_time_set_manual(int64_t unix_s)
{
	if (!time_sane(unix_s)) {
		/* The USB daemon's time push gets the same scrutiny as SNTP:
		 * the serial line is exactly as unauthenticated. */
		printk("[time] manual time %lld outside sane window; ignored\n",
		       (long long)unix_s);
		return;
	}

	k_spinlock_key_t key = k_spin_lock(&time_lock);

	sync_unix_s = unix_s;
	sync_uptime_ms = k_uptime_get();
	have_time = true;
	k_spin_unlock(&time_lock, key);
}

void net_time_set_offset(int32_t om)
{
	offset_min = om;
	have_offset = true;
}

bool net_time_local(int *hh, int *mm)
{
	if (!have_time || !have_offset) {
		return false;
	}

	int64_t sec_of_day = (now_unix() + (int64_t)offset_min * 60) % 86400;

	if (sec_of_day < 0) {
		sec_of_day += 86400;	/* western offsets near midnight */
	}
	*hh = (int)(sec_of_day / 3600);
	*mm = (int)((sec_of_day % 3600) / 60);
	return true;
}

/* Parse an unsigned decimal at *p, advancing past it. -1 if no digits. */
static int parse_num(const char **p)
{
	int v = 0;
	bool any = false;

	while (**p >= '0' && **p <= '9') {
		v = v * 10 + (**p - '0');
		(*p)++;
		any = true;
	}
	return any ? v : -1;
}

/* Minimal ISO-8601 parser: "YYYY-MM-DDThh:mm:ss" with an optional fractional
 * part and an optional trailing 'Z' or +hh:mm (which we treat as UTC -- the API
 * always emits UTC). Returns Unix seconds, or -1 on malformed input.
 *
 * Hand-rolled like every other parser in this firmware: newlib's sscanf
 * faulted in scanf_ungetc the first time it ever ran on this target (CPU
 * exception, 2026-07-14), so no scanf-family calls here. */
static int64_t parse_iso(const char *s)
{
	struct tm tm = {0};
	const char *p = s;
	int y, mo, d, h, mi, sec;

	y = parse_num(&p);
	if (y < 0 || *p++ != '-') {
		return -1;
	}
	mo = parse_num(&p);
	if (mo < 0 || *p++ != '-') {
		return -1;
	}
	d = parse_num(&p);
	if (d < 0 || (*p != 'T' && *p != 't')) {
		return -1;
	}
	p++;
	h = parse_num(&p);
	if (h < 0 || *p++ != ':') {
		return -1;
	}
	mi = parse_num(&p);
	if (mi < 0 || *p++ != ':') {
		return -1;
	}
	sec = parse_num(&p);
	if (sec < 0) {
		return -1;
	}
	tm.tm_year = y - 1900;
	tm.tm_mon = mo - 1;
	tm.tm_mday = d;
	tm.tm_hour = h;
	tm.tm_min = mi;
	tm.tm_sec = sec;
	return (int64_t)timeutil_timegm(&tm);
}

int32_t net_time_secs_until(const char *iso)
{
	if (!have_time || !iso || !iso[0]) {
		return -1;
	}

	int64_t target = parse_iso(iso);

	if (target < 0) {
		return -1;
	}

	int64_t rem = target - now_unix();

	if (rem < 0) {
		rem = 0;
	}
	if (rem > INT32_MAX) {
		rem = INT32_MAX;
	}
	return (int32_t)rem;
}
```
